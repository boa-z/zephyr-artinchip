## CMakeLists.txt
```
# SPDX-License-Identifier: Apache-2.0
cmake_minimum_required(VERSION 3.20.0)
find_package(Zephyr REQUIRED HINTS $ENV{ZEPHYR_BASE})
project(artinchip_handoff_probe)
execute_process(COMMAND git rev-parse HEAD WORKING_DIRECTORY ${CMAKE_CURRENT_SOURCE_DIR}
  OUTPUT_VARIABLE PROBE_SOURCE OUTPUT_STRIP_TRAILING_WHITESPACE COMMAND_ERROR_IS_FATAL ANY)
target_compile_definitions(app PRIVATE PROBE_SOURCE="${PROBE_SOURCE}")
target_sources(app PRIVATE src/main.c src/entry.S)
```

## prj.conf
```kconfig
CONFIG_ARTINCHIP_D13X_BOOT_CONTRACT=y
CONFIG_KERNEL_ENTRY="aic_handoff_entry"
CONFIG_PRINTK=y
CONFIG_MINIMAL_LIBC=y
CONFIG_MAIN_STACK_SIZE=2048
CONFIG_BOOT_BANNER=n
CONFIG_GPIO=n
CONFIG_DMA=n
CONFIG_NETWORKING=n
CONFIG_FILE_SYSTEM=n
CONFIG_DISPLAY=n
CONFIG_CAN=n
```

## product-window.overlay
```dts
/* SPDX-License-Identifier: Apache-2.0
 * Experimental link window, not a memory-map claim: 0x40000000 is where the D50T
 * SDK link script puts PSRAM_CMA (AIC_PSRAM_SIZE = 16 MiB), and this takes only
 * the first 64 KiB of the interval the original product firmware already
 * exercised. The loader owns XSPI/PSRAM initialisation and no Zephyr PSRAM driver
 * is enabled here, so an image linked into this window runs from loader-prepared
 * PSRAM; that is a consequence of the handoff, not evidence about PSRAM drivers.
 */
/ {
    chosen {
        zephyr,sram = &probe_window;
    };
    probe_window: memory@40000000 {
        compatible = "mmio-sram";
        reg = <0x40000000 0x10000>;
    };
};
```

## src/main.c
```c
/* SPDX-License-Identifier: Apache-2.0 */
#include <stdint.h>
#include <zephyr/kernel.h>
#include <zephyr/sys/printk.h>

/* The entry stores every field before Zephyr's BSS clearing; no stack use. */
uint32_t aic_handoff_snapshot[33] __attribute__((section(".noinit"), aligned(16)));
uint32_t aic_early_uart_status __attribute__((section(".noinit"), aligned(4)));
uint32_t aic_mtime_status __attribute__((section(".noinit"), aligned(4)));
extern void aic_handoff_entry(void);

int main(void)
{
 static const char *const names[] = {
  "marker", "sp", "gp", "boot_device_a0", "boot_args_a1", "mstatus", "mie",
  "mip", "mtvec", "mtvt", "mexstatus", "mxstatus", "mhcr", "fcsr_or_skipped",
  "clicinfo", "mtime_low", "mtime_high"
 };
 printk("H0-PROBE sequence=1 source=%s entry=%p buffer=%p bytes=%u\n",
        PROBE_SOURCE, aic_handoff_entry, aic_handoff_snapshot,
        (unsigned int)sizeof(aic_handoff_snapshot));
 printk("ELF_SHA256=external:candidate.json privilege=expected-M-not-measured\n");
 printk("H0-PROBE stage=main early_uart_status=%u (1=attempted,2=submitted,3=DLAB,4=timeout)\n",
        aic_early_uart_status);
 if (aic_handoff_snapshot[0] != 0x48305031) {
  printk("H0-PROBE FAIL snapshot marker\n");
  return 1;
 }
 for (unsigned int i = 0; i < ARRAY_SIZE(names); i++) {
  printk("%s=0x%08x\n", names[i], aic_handoff_snapshot[i]);
 }
 for (unsigned int i = 0; i < 8; i++) {
  printk("sysmap%u_addr=0x%08x cfg=0x%08x\n", i,
         aic_handoff_snapshot[17 + 2 * i], aic_handoff_snapshot[18 + 2 * i]);
 }
 printk("TCM=not-captured; no-unverified-register-probes\n");
 printk("H0-PROBE CAPTURED hardware-acceptance=pending\n");
 return 0;
}
```
