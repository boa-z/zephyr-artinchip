## Kconfig
```kconfig
# SPDX-License-Identifier: Apache-2.0
config ARTINCHIP_MODULE
	bool
	default y
	help
	  Identifies the out-of-tree ArtInChip module in the generated configuration.
```

## boards/boa/d50t_2_lite/Kconfig.d50t_2_lite
```kconfig
# SPDX-License-Identifier: Apache-2.0
config BOARD_D50T_2_LITE
	select SOC_D133ECS
```

## boards/boa/d50t_2_lite/board.yml
```yaml
board:
  name: d50t_2_lite
  full_name: D50T-2-Lite D133ECS (software candidate)
  vendor: boa
  socs:
    - name: d133ecs
```

## boards/boa/d50t_2_lite/d50t_2_lite_defconfig
```kconfig
CONFIG_SERIAL=y
CONFIG_CONSOLE=y
CONFIG_UART_CONSOLE=y
CONFIG_UART_NS16550_ACCESS_WORD_ONLY=y
CONFIG_UART_NS16550_DW8250_DW_APB=y
CONFIG_XIP=n
CONFIG_FPU=y
CONFIG_FPU_SHARING=y
CONFIG_STACK_SENTINEL=y
```

## soc/artinchip/d13x/Kconfig
```kconfig
# SPDX-License-Identifier: Apache-2.0
config SOC_SERIES_D13X
	select RISCV
	select CPU_XUANTIE_E907
	select SOC_RESET_HOOK
	select LEGACY_CLIC_MEMORYMAP_ACCESS
	select CLIC_LEGACY_MMIO_LAYOUT
	select CLIC_SMCLICCONFIG_EXT
	select CLIC_SMCLICSHV_EXT
	select RISCV_NO_MTVAL_ON_FP_TRAP
	select RISCV_NO_MTVAL_ON_FP_TRAP_UNALIGNED
	select RISCV_SOC_CONTEXT_SAVE

if SOC_SERIES_D13X

config ARTINCHIP_D13X_BOOT_CONTRACT
	bool "Acknowledge the documented bootloader handoff"
	help
	  Acknowledgement that the loader must enter in M-mode with the linked
	  SRAM or PSRAM region accessible, interrupt delivery disabled, instruction
	  coherency established, and UART0 clock/pins configured. Compiling the SoC
	  does not require it; scripts/package_candidate.py refuses to collect a
	  build into a hardware candidate without it, so the flag marks intent to
	  run on the board rather than the ability to build.
	  Read docs/bringup/d13x-boot-contract.md before any hardware use.

endif
```

## soc/artinchip/d13x/Kconfig.soc
```kconfig
# SPDX-License-Identifier: Apache-2.0
config SOC_FAMILY_ARTINCHIP
	bool

config SOC_FAMILY
	default "artinchip" if SOC_FAMILY_ARTINCHIP

config SOC_SERIES_D13X
	bool
	select SOC_FAMILY_ARTINCHIP

config SOC_SERIES
	default "d13x" if SOC_SERIES_D13X

config SOC_D133ECS
	bool
	select SOC_SERIES_D13X

config SOC
	default "d133ecs" if SOC_D133ECS
```

## tests/clic/Kconfig
```kconfig
# SPDX-License-Identifier: Apache-2.0
mainmenu "CLIC register regression"
source "Kconfig.zephyr"

config AIC_CLIC_TEST_LEGACY
	bool "Test legacy register layout"
	default n

config AIC_CLIC_TEST_NUCLEI
	bool "Test Nuclei register layout"
	default n
```

## west.yml
```yaml
# SPDX-License-Identifier: Apache-2.0
manifest:
  remotes:
    - name: zephyrproject-rtos
      url-base: https://github.com/zephyrproject-rtos
  projects:
    - name: zephyr
      remote: zephyrproject-rtos
      path: zephyr-upstream
      revision: 839728050444f90d06870b5fc9bbbda106d91459
      # P0/Z0 builds use only in-tree drivers and SDK libc.
      import:
        path-blocklist: ['*']
  self:
    path: zephyr-artinchip
```
